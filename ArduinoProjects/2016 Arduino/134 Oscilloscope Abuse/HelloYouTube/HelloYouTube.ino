// Drawing letters on scope by Hari Wiguna, 2016
// Playing with R-2R Ladder to convert Digital to Analog
// We'll use PORTD because it gives us contiguous 8 bits
// Font courtesy of: http://jared.geek.nz/2014/jan/custom-fonts-for-microcontrollers

const uint8_t fontWidth = 8;
const PROGMEM uint8_t font[]  = {
  0x00,0x00,0x00,0x00,0x00,0x00,0x00,0x00, //  
  0x00,0x5f,0x00,0x00,0x00,0x00,0x00,0x00, // !
  0x00,0x03,0x00,0x03,0x00,0x00,0x00,0x00, // "
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  0x00,0x00,0x00,0x00,0x00,0x00,0x00,0x00
};

char topWord[] =    " HELLO ";
char bottomWord[] = "YouTube";

void setup() {
  DDRD = B11111111; // Set all bits of PORTD as output
}

void loop() {
  MultiChar();
}

void MultiChar()
{
  int horizUnit = 250;
  PORTD = 250;
  
  for (uint8_t i = 0; i < sizeof(topWord) - 1; i++)
  {
    for (uint8_t x = 0; x < fontWidth; x++)
    {
      for (uint8_t r = 0; r < 2; r++)
      {
        int ch = ((r == 0) ? bottomWord[i] : topWord[i]) - ' ';
        uint8_t rowOffset = 80 * r;
        uint8_t bitAnalogValue = 40 + rowOffset;
        unsigned char vertByte = pgm_read_byte_near(font + ch*8 + x);
        for (uint8_t y = 0; y <= 7; y++)
        {
          bitAnalogValue += 7;
          if (bitRead(vertByte, 7 - y)) PORTD = bitAnalogValue;// else PORTD = 0;
          delayMicroseconds(horizUnit);
        }
      }
    }
    PORTD = 0;  delayMicroseconds(500);
  }
  delay(20);
}
